## boards/shields/test/Kconfig.defconfig
```kconfig
if SHIELD_REVIUNG41

# Name must be less than 16 characters long!
config ZMK_KEYBOARD_NAME
    default "reviung41"

endif
```

## boards/shields/test/Kconfig.sheild
```kconfig
# No whitespace after the comma or in your keyboard name!
config SHIELD_REVIUNG41
    def_bool $(shields_list_contains,reviung41)
```
