#include <behaviors.dtsi>
#include <dt-bindings/zmk/keys.h>

/{
    keymap {
        compatible = "zmk,keymap";
        default_layer { //layer 0
            bindings = <
                            &kp F   $kp P   &kp D   &kp L   &kp X       &kp BSPC    &kp U           &kp O   &kp Y       &kp B
                &kp TAB     &kp S   &kp N   &kp T   &kp H   &kp K       &kp COMMA   &kp A           &kp E   &kp I       &kp C   &kp Q}
                &kp LCTRL   &kp V   &kp W   &kp G   &kp M   &kp J       &kp MINUS   &mt EXCL DOT    &kp SQT &kp SEMI    &kp Z   &kp LALT
                                                    &kp rc  &kp CAPS    &kp LSHIFT  &kp SPACE
            >;
        };
};!